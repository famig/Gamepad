## config/boards/shields/gamepad/Kconfig.defconfig
```kconfig
if SHIELD_GamePad

config ZMK_KEYBOARD_NAME
    default "GamePad"

config ZMK_BLE
    def_bool n

config SETTINGS
    def_bool n

endif
```
